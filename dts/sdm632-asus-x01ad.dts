// SPDX-License-Identifier: GPL-2.0-only

/dts-v1/;

/include/ "msm8953.dtsi"

/ {
	// This is used by the bootloader to find the correct DTB
	qcom,msm-id = <0x15d 0x00>;
	qcom,board-id = <0x08 0x03>;

	qcom,msm-name = "SDM632";
	qcom,pmic-id = <0x10016 0x25 0x00 0x00>;

	model = "Qualcomm Technologies, Inc. SDM632 + PMI632 SOC";
	compatible = "qcom,sdm450", "qcom,sdm632", "qcom,msm8953", "lk2nd,device";
	
	lk2nd,pstore = <0xef000000 0xbf800>;
};
